/* Custom */
#ifdef MI8937_V2
#include "../../../common/include/msm-cdc-pinctrl.h"
MSM_CDC_PINCTRL_PA_GPIO_SINGLE_PIN(spk, gpio124)
#endif

&int_codec {
	qcom,audio-routing =
		"RX_BIAS", "MCLK",
		"SPK_RX_BIAS", "MCLK",
		"INT_LDO_H", "MCLK",
		"RX_I2S_CLK", "MCLK",
		"TX_I2S_CLK", "MCLK",
		"MIC BIAS External", "Handset Mic",
		"MIC BIAS Internal2", "Headset Mic",
		"MIC BIAS External", "Secondary Mic",
		"AMIC1", "MIC BIAS External",
		"AMIC2", "MIC BIAS Internal2",
		"AMIC3", "MIC BIAS External",
		"ADC1_IN", "ADC1_OUT",
		"ADC2_IN", "ADC2_OUT",
		"ADC3_IN", "ADC3_OUT",
		"PDM_IN_RX1", "PDM_OUT_RX1",
		"PDM_IN_RX2", "PDM_OUT_RX2",
		"PDM_IN_RX3", "PDM_OUT_RX3"
#ifdef MI8937_V2
		,
		"HPH PA GPIO Switch", "HPHL PA",
		"HPH PA GPIO Switch", "HPHR PA",
		"SPK PA GPIO Switch", "HPHR PA"
#endif
		;
};

/* From stock msm-audio.dtsi */
&int_codec {
#ifndef MI8937_V2
	ext-spk-amp-gpio = <&tlmm 124 0>;
#endif
};
